/**
 * @file pytorch_parity_gtest.cpp
 * @brief Ground-truth parity tests: compare EVERY tensor backend against
 * PyTorch/snnTorch.
 *
 * References are generated by scripts/testing/gen_pytorch_refs.py (requires
 * torch + snntorch) into fixtures/pytorch_refs.npz — committed so this test
 * needs no torch/snntorch at build/CI time. Each case sets the same
 * weights + input into our layer, runs forward/backward, and asserts
 * EXPECT_NEAR against PyTorch's/snnTorch's output/gradients.
 *
 * Every test is a TYPED_TEST run once per concrete backend
 * (XTensorBackend, OpenCLTensorBackend, DeviceTensorBackend, and
 * SYCLTensorBackend when NN_BACKEND=SYCL) against the SAME fixture data —
 * this is deliberately independent of whichever backend NN_BACKEND selects
 * as nn::Backend for the rest of the project, so a single build validates
 * every backend's numerics against the same external ground truth rather
 * than only whichever one happens to be "primary" in that build.
 *
 * Regenerate after touching a covered layer:
 *   software/nn/.venv/bin/python software/nn/scripts/testing/gen_pytorch_refs.py
 */
#include <gtest/gtest.h>

#include <algorithm>
#include <cmath>
#include <cstdint>
#include <filesystem>
#include <string>

#include "cnpy.h"
#include "layers/Layers.hpp"
#include "tensor/DeviceTensorBackend.hpp"
#include "tensor/Tensor.hpp"
#include "tensor/opencl/OpenCLTensorBackend.hpp"
#include "tensor/xtensor/XTensorBackend.hpp"
#ifdef NN_BACKEND_SYCL
#include "tensor/sycl/SYCLTensorBackend.hpp"
#endif

namespace
{

using XT = nn::XTensorBackend;
using CL = nn::OpenCLTensorBackend;
using DV = nn::DeviceTensorBackend;

// Per-backend tolerance: GPU fp32 kernels round differently from the host
// serial loops, so chained/reduced ops need a looser bound than the default
// used for the exact host-math backends (XTensor, and Device — which is
// itself just an XTensor host mirror, see DeviceTensorBackend.hpp).
template <typename Backend>
constexpr float parity_tol()
{
    return 1e-4F;
}
template <>
constexpr float parity_tol<CL>()
{
    return 3e-4F;
}
#ifdef NN_BACKEND_SYCL
using SY = nn::SYCLTensorBackend;
template <>
constexpr float parity_tol<SY>()
{
    return 3e-4F;
}
#endif

// Skip gracefully for backends whose device isn't actually present at test
// run time. XTensor and Device never need this (Device is host math only).
// OpenCLTensorBackend.cpp/SYCLTensorBackend.cpp are the only backends that
// throw rather than silently running on host if no device is available (see
// cmake/OpenCLGpuCapabilityCheck.cmake / SyclGpuCapabilityCheck.cmake for the
// configure-time side of that "no fallback" policy) — skip here instead of
// letting every TYPED_TEST fail identically when a device is genuinely
// absent (e.g. CI runners without a GPU).
template <typename Backend>
void skip_if_backend_unavailable()
{
}
template <>
void skip_if_backend_unavailable<CL>()
{
    if (!nn::opencl::OpenCLContext::instance().is_available())
        GTEST_SKIP() << "No OpenCL device available — parity suite skipped for OpenCLTensorBackend";
}
#ifdef NN_BACKEND_SYCL
template <>
void skip_if_backend_unavailable<SY>()
{
    if (!SY::sycl_runtime_available())
        GTEST_SKIP() << "No SYCL device available — parity suite skipped for SYCLTensorBackend";
}
#endif

const cnpy::npz_t& refs()
{
    static const cnpy::npz_t data = []
    {
        const std::filesystem::path p =
            std::filesystem::path(__FILE__).parent_path() / "fixtures" / "pytorch_refs.npz";
        return cnpy::npz_load(p.string());
    }();
    return data;
}

const cnpy::NpyArray& arr(const std::string& key)
{
    const auto it = refs().find(key);
    EXPECT_NE(it, refs().end()) << "missing fixture key: " << key;
    return it->second;
}

// IMPORTANT: use only the structured accessors at(i,j)/at(i,j,k)/at(i,j,k,l),
// never the linear at(k). The linear accessor exposes backend storage order
// (row-major for xtensor, column-major for the OpenCL backend), so filling a
// tensor from row-major fixture data via at(k) would transpose it on OpenCL.
// at(i,j)… address the same *logical* element on every backend. Fixture arrays
// are numpy C-order, so a C-order multi-index walk matches them.
using Shape = std::vector<nn::Index>;

Shape shape_of(const cnpy::NpyArray& a)
{
    Shape s;
    s.reserve(a.shape.size());
    for (size_t d : a.shape) s.push_back(static_cast<nn::Index>(d));
    return s;
}

template <typename Tensor>
float& elem(Tensor& t, const Shape& i)
{
    switch (i.size())
    {
        case 2:
            return t.at(i[0], i[1]);
        case 3:
            return t.at(i[0], i[1], i[2]);
        case 4:
            return t.at(i[0], i[1], i[2], i[3]);
        default:
            throw std::invalid_argument("parity test: unsupported tensor rank");
    }
}

template <typename Tensor>
float elem(const Tensor& t, const Shape& i)
{
    switch (i.size())
    {
        case 2:
            return t.at(i[0], i[1]);
        case 3:
            return t.at(i[0], i[1], i[2]);
        case 4:
            return t.at(i[0], i[1], i[2], i[3]);
        default:
            throw std::invalid_argument("parity test: unsupported tensor rank");
    }
}

// Advance a C-order multi-index; returns false after the last element.
bool next_index(Shape& idx, const Shape& shape)
{
    for (int d = static_cast<int>(idx.size()) - 1; d >= 0; --d)
    {
        if (++idx[static_cast<size_t>(d)] < shape[static_cast<size_t>(d)]) return true;
        idx[static_cast<size_t>(d)] = 0;
    }
    return false;
}

// Build a tensor of the fixture array's own shape, filled via structured indices.
template <typename Tensor>
Tensor make_from(const cnpy::NpyArray& a)
{
    const Shape s = shape_of(a);
    Tensor t = (s.size() == 2) ? Tensor(s[0], s[1]) : Tensor(s);
    const float* d = a.data<float>();
    size_t k = 0;
    Shape idx(s.size(), 0);
    do
    {
        elem(t, idx) = d[k++];
    } while (next_index(idx, s));
    return t;
}

// Build a 2-D (rows x cols) tensor from a flat C-order buffer of that shape.
template <typename Tensor>
Tensor make_2d_flat(const float* d, nn::Index rows, nn::Index cols)
{
    Tensor t(rows, cols);
    for (nn::Index i = 0; i < rows; ++i)
        for (nn::Index j = 0; j < cols; ++j)
            t.at(i, j) =
                d[static_cast<size_t>(i) * static_cast<size_t>(cols) + static_cast<size_t>(j)];
    return t;
}

// Overwrite an existing tensor's values from a fixture array of the same shape.
template <typename Tensor>
void fill_from(Tensor& dst, const cnpy::NpyArray& a)
{
    const Shape s = shape_of(a);
    ASSERT_EQ(static_cast<size_t>(dst.size()), a.num_vals);
    const float* d = a.data<float>();
    size_t k = 0;
    Shape idx(s.size(), 0);
    do
    {
        elem(dst, idx) = d[k++];
    } while (next_index(idx, s));
}

// Compare `got` to a C-order fixture array. Iterates got's OWN logical shape and
// reads the reference in lockstep C-order, so it is agnostic to backend storage
// order AND to a rank difference that flattens the same way (e.g. our LIF output
// is 2-D (T*B,F) while the reference is 3-D (T,B,F) — same C-order sequence).
template <typename Tensor>
void expect_close(const Tensor& got, const cnpy::NpyArray& ref, const std::string& what, float tol)
{
    ASSERT_EQ(static_cast<size_t>(got.size()), ref.num_vals) << what << ": size mismatch";
    const Shape s = got.get_shape();
    const float* d = ref.data<float>();
    size_t k = 0;
    Shape idx(s.size(), 0);
    do
    {
        EXPECT_NEAR(elem(got, idx), d[k], tol) << what << " at C-index " << k;
        ++k;
    } while (next_index(idx, s));
}

#ifdef NN_BACKEND_SYCL
using AllBackends = ::testing::Types<XT, CL, DV, SY>;
#else
using AllBackends = ::testing::Types<XT, CL, DV>;
#endif

template <typename B>
class PyTorchParityTyped : public ::testing::Test
{
   protected:
    using Backend = B;
    using Tensor = nn::TensorImpl<B>;

    void SetUp() override
    {
        skip_if_backend_unavailable<B>();
    }
    static float tol()
    {
        return parity_tol<B>();
    }
};

TYPED_TEST_SUITE(PyTorchParityTyped, AllBackends);

} // namespace

// ── Linear: forward + input/weight/bias gradients ─────────────────────────────
TYPED_TEST(PyTorchParityTyped, Linear)
{
    using B = typename TestFixture::Backend;
    using Tensor = typename TestFixture::Tensor;
    const float tol = TestFixture::tol();

    const int n = static_cast<int>(arr("linear_num").data<int64_t>()[0]);
    for (int i = 0; i < n; ++i)
    {
        const std::string p = "linear_" + std::to_string(i) + "_";
        const auto& W = arr(p + "weight");
        const int out_f = static_cast<int>(W.shape[0]);
        const int in_f = static_cast<int>(W.shape[1]);

        LinearImpl<B> lin(in_f, out_f);
        fill_from(lin.weight, W);
        fill_from(lin.bias, arr(p + "bias"));

        Tensor x = make_from<Tensor>(arr(p + "input"));
        Tensor y = lin.forward(x, true);
        expect_close(y, arr(p + "output"), p + "output", tol);

        Tensor go = make_from<Tensor>(arr(p + "grad_output"));
        Tensor gi = lin.backward(go);
        expect_close(gi, arr(p + "grad_input"), p + "grad_input", tol);
        expect_close(lin.weight.grad(), arr(p + "grad_weight"), p + "grad_weight", tol);
        expect_close(lin.bias.grad(), arr(p + "grad_bias"), p + "grad_bias", tol);
    }
}

// ── Elementwise activations: forward + backward ───────────────────────────────
namespace
{
template <typename Layer, typename Tensor>
void check_activation(const std::string& name, float tol)
{
    const std::string p = "act_" + name + "_";
    Layer layer;
    Tensor x = make_from<Tensor>(arr(p + "input"));
    Tensor y = layer.forward(x, true);
    expect_close(y, arr(p + "output"), p + "output", tol);

    Tensor go = make_from<Tensor>(arr(p + "grad_output"));
    Tensor gi = layer.backward(go);
    expect_close(gi, arr(p + "grad_input"), p + "grad_input", tol);
}
} // namespace

TYPED_TEST(PyTorchParityTyped, Tanh)
{
    using B = typename TestFixture::Backend;
    check_activation<TanhImpl<B>, typename TestFixture::Tensor>("tanh", TestFixture::tol());
}
TYPED_TEST(PyTorchParityTyped, Sigmoid)
{
    using B = typename TestFixture::Backend;
    check_activation<SigmoidImpl<B>, typename TestFixture::Tensor>("sigmoid", TestFixture::tol());
}
TYPED_TEST(PyTorchParityTyped, ReLU)
{
    using B = typename TestFixture::Backend;
    check_activation<ReLUImpl<B>, typename TestFixture::Tensor>("relu", TestFixture::tol());
}
TYPED_TEST(PyTorchParityTyped, LeakyReLU)
{
    using B = typename TestFixture::Backend;
    check_activation<LeakyReLUImpl<B>, typename TestFixture::Tensor>("leaky", TestFixture::tol());
}

// ── MSELoss: scalar loss + gradient w.r.t. prediction ─────────────────────────
TYPED_TEST(PyTorchParityTyped, MSELoss)
{
    using B = typename TestFixture::Backend;
    using Tensor = typename TestFixture::Tensor;
    const float tol = TestFixture::tol();

    MSELossImpl<B> loss;
    loss.set_target(make_from<Tensor>(arr("mse_target")));
    Tensor pred = make_from<Tensor>(arr("mse_pred"));
    Tensor l = loss.forward(pred, true);
    EXPECT_NEAR(l.at(0, 0), arr("mse_loss").data<float>()[0], tol);

    Tensor gp = loss.backward(pred);
    expect_close(gp, arr("mse_grad_pred"), "mse_grad_pred", tol);
}

// ── LSTMLayer: forward (all hidden states) for a batched sequence ──────────────
//
// Our LSTM uses rational-approximation sigmoid/tanh (FastActivations.hpp) for
// speed, so it cannot bit-match PyTorch's exact activations. Two checks:
//   1. Tight vs. a numpy reference using the *same* rational approximation —
//      proves the recurrence, gate order (i,f,o,g), and weight orientation are
//      correct.
//   2. Loose vs. PyTorch's exact-activation output — documents the accuracy gap
//      the fast activations introduce (bounded well under the saturation error).
TYPED_TEST(PyTorchParityTyped, LSTMLayerForward)
{
    using B = typename TestFixture::Backend;
    using Tensor = typename TestFixture::Tensor;
    const float tol = TestFixture::tol();

    const int n = static_cast<int>(arr("lstm_num").data<int64_t>()[0]);
    for (int i = 0; i < n; ++i)
    {
        const std::string p = "lstm_" + std::to_string(i) + "_";
        const auto dims = arr(p + "dims").data<int64_t>();
        const int D = static_cast<int>(dims[2]);
        const int H = static_cast<int>(dims[3]);

        // ── (1) DEFAULT: exact activations must match torch.nn.LSTM exactly ──
        // exact_activations defaults to true, so our gates are the real sigmoid/tanh and
        // there is nothing left to approximate: this is a tight, element-wise comparison
        // against PyTorch itself. It used to be a loose 0.25 bound because the layer
        // unconditionally used FastActivations' softsign gates.
        {
            LSTMLayerImpl<B> layer(D, H);
            // Fixture weights are already in our gate order (i,f,o,g) with merged bias.
            fill_from(layer.W_, arr(p + "W"));
            fill_from(layer.U_, arr(p + "U"));
            fill_from(layer.b_, arr(p + "b"));
            ASSERT_TRUE(layer.exact_activations) << "exact activations must be the default";

            Tensor x = make_from<Tensor>(arr(p + "input"));
            layer.reset_state();
            Tensor y = layer.forward(x, false);
            expect_close(y, arr(p + "output"), p + "output (vs torch.nn.LSTM)", tol);
        }

        // ── (2) OPT-IN fast mode: matches the rational-approx recurrence, not torch ──
        // Kept so the speed/fidelity trade stays exercised and honest: when a profile sets
        // numerics.exact_activations=false the layer becomes a softsign-gated LSTM, which is
        // ~2x cheaper but provably NOT torch (|tanh - tanh_fast| reaches 0.306 on [-4,4]).
        {
            LSTMLayerImpl<B> layer(D, H);
            layer.exact_activations = false;
            fill_from(layer.W_, arr(p + "W"));
            fill_from(layer.U_, arr(p + "U"));
            fill_from(layer.b_, arr(p + "b"));

            Tensor x = make_from<Tensor>(arr(p + "input"));
            layer.reset_state();
            Tensor y = layer.forward(x, false);
            expect_close(y, arr(p + "output_approx"), p + "output_approx (fast mode)", tol);
        }
    }
}

// ── LifBPTT spiking neuron vs snnTorch Leaky ──────────────────────────────────
// Our recurrence v[t]=beta*v[t-1]+input[t], spike on v>V_th, subtract/zero reset
// matches snn.Leaky(beta, threshold, reset_mechanism). R=C=1, delta_t=-ln(beta)
// so beta = exp(-delta_t/(R*C)) reproduces snnTorch's beta.
TYPED_TEST(PyTorchParityTyped, LifBPTTvsSnnTorch)
{
    using B = typename TestFixture::Backend;
    using Tensor = typename TestFixture::Tensor;
    const float tol = TestFixture::tol();

    const int n = static_cast<int>(arr("lif_num").data<int64_t>()[0]);
    for (int i = 0; i < n; ++i)
    {
        const std::string p = "lif_" + std::to_string(i) + "_";
        const auto dims = arr(p + "dims").data<int64_t>();
        const int T = static_cast<int>(dims[0]);
        const int B_ = static_cast<int>(dims[1]);
        const int F = static_cast<int>(dims[2]);
        const float* prm = arr(p + "params").data<float>();
        const float delta_t = prm[0];
        const float R = prm[1];
        const float C = prm[2];
        const float vth = prm[3];
        const bool reset_zero = prm[4] > 0.5F;
        const bool readout = prm[5] > 0.5F;

        LifBPTTImpl<B> lif(T, delta_t, R, C, vth, reset_zero, 0.0F, readout);

        // Fixture input is (T,B,F) C-order == time-major (T*B, F) rows (t0 batch,
        // then t1 batch, …) — exactly what LifBPTT expects.
        const auto& in = arr(p + "input");
        Tensor x = make_2d_flat<Tensor>(
            in.data<float>(), static_cast<nn::Index>(T * B_), static_cast<nn::Index>(F));

        lif.reset_state();
        Tensor y = lif.forward(x, false);

        // readout → membrane (compare to snnTorch mem); spike mode → spike train.
        expect_close(y, arr(p + (readout ? "mem" : "spk")), p + (readout ? "mem" : "spk"), tol);
    }
}

// ── LifBPTT readout backward vs snnTorch autograd (exact BPTT temporal grad) ──
// Pure leaky integrator (readout mode, no spike/reset): dL/dinput through
// v[t]=beta*v[t-1]+input[t] for loss = sum(all membranes) must match snnTorch's
// autograd exactly (no surrogate/reset involved).
TYPED_TEST(PyTorchParityTyped, LifBPTTReadoutBackward)
{
    using B = typename TestFixture::Backend;
    using Tensor = typename TestFixture::Tensor;
    const float tol = TestFixture::tol();

    const int n = static_cast<int>(arr("lifbw_num").data<int64_t>()[0]);
    for (int i = 0; i < n; ++i)
    {
        const std::string p = "lifbw_" + std::to_string(i) + "_";
        const auto dims = arr(p + "dims").data<int64_t>();
        const int T = static_cast<int>(dims[0]);
        const int B_ = static_cast<int>(dims[1]);
        const int F = static_cast<int>(dims[2]);
        const float* prm = arr(p + "params").data<float>();

        LifBPTTImpl<B> lif(T,
            prm[0],
            prm[1],
            prm[2],
            /*V_th=*/1.0F,
            /*reset_zero=*/false,
            /*reset_potential=*/0.0F,
            /*readout_mode=*/true);

        // Arbitrary input; only the gradient path is checked (dL/dinput of a linear
        // integrator is input-independent). Fill via the structured accessor.
        Tensor x(static_cast<nn::Index>(T * B_), static_cast<nn::Index>(F));
        for (nn::Index r = 0; r < static_cast<nn::Index>(T * B_); ++r)
            for (nn::Index c = 0; c < static_cast<nn::Index>(F); ++c)
                x.at(r, c) = 0.1F * static_cast<float>(((r * F + c) % 7) - 3);

        lif.reset_state();
        (void) lif.forward(x, true);
        // loss = sum(all membranes) → dL/d(membrane)=1 everywhere.
        Tensor grad_out(static_cast<nn::Index>(T * B_), static_cast<nn::Index>(F));
        for (nn::Index r = 0; r < static_cast<nn::Index>(T * B_); ++r)
            for (nn::Index c = 0; c < static_cast<nn::Index>(F); ++c) grad_out.at(r, c) = 1.0F;

        Tensor grad_in = lif.backward(grad_out);
        expect_close(grad_in, arr(p + "grad_input"), p + "grad_input", tol);
    }
}

// ── Conv1d vs torch.nn.Conv1d (valid, stride 1) ───────────────────────────────
TYPED_TEST(PyTorchParityTyped, Conv1d)
{
    using B = typename TestFixture::Backend;
    using Tensor = typename TestFixture::Tensor;
    const float tol = TestFixture::tol();

    const int n = static_cast<int>(arr("conv1d_num").data<int64_t>()[0]);
    for (int i = 0; i < n; ++i)
    {
        const std::string p = "conv1d_" + std::to_string(i) + "_";
        const auto dims = arr(p + "dims").data<int64_t>();
        const int Cin = static_cast<int>(dims[1]);
        const int Cout = static_cast<int>(dims[2]);
        const int K = static_cast<int>(dims[4]);

        Conv1dImpl<B> conv(Cin, Cout, K, /*stride=*/1, /*padding=*/0, /*dilation=*/1);
        conv.set_weights(make_from<Tensor>(arr(p + "weight"))); // (Cin*K, Cout)
        conv.set_bias(make_from<Tensor>(arr(p + "bias")));      // (1, Cout)

        Tensor x = make_from<Tensor>(arr(p + "input")); // (N, Cin, L)
        Tensor y = conv.forward(x, false);              // (N, Cout, L-K+1)
        expect_close(y, arr(p + "output"), p + "output", tol);
    }
}

// ── Conv2d vs torch.nn.Conv2d (valid, stride 1, square kernel) ────────────────
TYPED_TEST(PyTorchParityTyped, Conv2d)
{
    using B = typename TestFixture::Backend;
    using Tensor = typename TestFixture::Tensor;
    const float tol = TestFixture::tol();

    const int n = static_cast<int>(arr("conv2d_num").data<int64_t>()[0]);
    for (int i = 0; i < n; ++i)
    {
        const std::string p = "conv2d_" + std::to_string(i) + "_";
        const auto dims = arr(p + "dims").data<int64_t>();
        const int Cin = static_cast<int>(dims[1]);
        const int Cout = static_cast<int>(dims[2]);
        const int K = static_cast<int>(dims[5]);

        Conv2dImpl<B> conv(Cin, Cout, K, /*stride=*/1, /*padding=*/0, /*dilation=*/1);
        conv.set_weights(make_from<Tensor>(arr(p + "weight"))); // (Cin*K*K, Cout)
        conv.set_bias(make_from<Tensor>(arr(p + "bias")));      // (1, Cout)

        Tensor x = make_from<Tensor>(arr(p + "input")); // (N, Cin, H, W)
        Tensor y = conv.forward(x, false);              // (N, Cout, H-K+1, W-K+1)
        expect_close(y, arr(p + "output"), p + "output", tol);
    }
}

// ── CrossEntropyLoss (softmax+CE, mean) vs torch ──────────────────────────────
TYPED_TEST(PyTorchParityTyped, CrossEntropyLoss)
{
    using B = typename TestFixture::Backend;
    using Tensor = typename TestFixture::Tensor;
    const float tol = TestFixture::tol();

    const int n = static_cast<int>(arr("ce_num").data<int64_t>()[0]);
    for (int i = 0; i < n; ++i)
    {
        const std::string p = "ce_" + std::to_string(i) + "_";
        CrossEntropyLossImpl<B> loss;
        loss.set_target(make_from<Tensor>(arr(p + "target"))); // one-hot (N,C)
        Tensor logits = make_from<Tensor>(arr(p + "logits"));
        Tensor l = loss.forward(logits, true);
        EXPECT_NEAR(l.at(0, 0), arr(p + "loss").data<float>()[0], tol) << p << "loss";
        Tensor g = loss.backward(logits);
        expect_close(g, arr(p + "grad_logits"), p + "grad_logits", tol);
    }
}

// ── MaxPool1d / MaxPool2d (forward) vs torch ──────────────────────────────────
TYPED_TEST(PyTorchParityTyped, MaxPool1d)
{
    using B = typename TestFixture::Backend;
    using Tensor = typename TestFixture::Tensor;
    const float tol = TestFixture::tol();

    const int n = static_cast<int>(arr("maxpool1d_num").data<int64_t>()[0]);
    for (int i = 0; i < n; ++i)
    {
        const std::string p = "maxpool1d_" + std::to_string(i) + "_";
        const auto pr = arr(p + "params").data<int64_t>();
        MaxPool1dImpl<B> pool(static_cast<int>(pr[0]), static_cast<int>(pr[1]));
        Tensor x = make_from<Tensor>(arr(p + "input")); // (N, C, L)
        Tensor y = pool.forward(x, false);
        expect_close(y, arr(p + "output"), p + "output", tol);
    }
}

TYPED_TEST(PyTorchParityTyped, MaxPool2d)
{
    using B = typename TestFixture::Backend;
    using Tensor = typename TestFixture::Tensor;
    const float tol = TestFixture::tol();

    const int n = static_cast<int>(arr("maxpool2d_num").data<int64_t>()[0]);
    for (int i = 0; i < n; ++i)
    {
        const std::string p = "maxpool2d_" + std::to_string(i) + "_";
        const auto pr = arr(p + "params").data<int64_t>();
        MaxPool2dImpl<B> pool(static_cast<int>(pr[0]), static_cast<int>(pr[1]));
        Tensor x = make_from<Tensor>(arr(p + "input")); // (N, C, H, W)
        Tensor y = pool.forward(x, false);
        expect_close(y, arr(p + "output"), p + "output", tol);
    }
}
