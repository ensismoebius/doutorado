/**
 * @file src/core/layers/tests/independent_refs_gtest.cpp
 * @brief INDEPENDENT NumPy cross-check for SpikeTimeLoss and PoissonLatentLayer.
 *
 * IMPORTANT — this file is deliberately NOT the same rigor as pytorch_parity_gtest.cpp /
 * optimizer_parity_gtest.cpp. Those diff our C++ against an external library (PyTorch,
 * snnTorch, the authors' own optimizer packages) — genuine ground truth written by someone
 * else. No external library implements SpikeTimeLoss's first-spike-time MSE or
 * PoissonLatentLayer's Poisson-VAE reparameterization (confirmed during the investigation
 * behind this file: snnTorch's `ce_temporal_loss` is classification cross-entropy against a
 * class label, not this; `spikegen.rate` is Bernoulli image encoding, not this).
 *
 * What this file actually is: a SECOND, INDEPENDENT re-derivation of the same documented
 * formula (see each header's docstring), written in NumPy directly from the prose/formula
 * comments rather than transliterated from the C++ source line-by-line
 * (scripts/testing/gen_independent_refs.py). It catches "the C++ doesn't match its own
 * documented formula" bugs. It does NOT catch "the documented formula itself is wrong"
 * bugs the way a real external-library parity test would — do not read a pass here as
 * carrying the same evidentiary weight as pytorch_parity_gtest passing. Call this a
 * "cross-check" / "independent re-derivation", never "ground truth" or "parity".
 *
 * Fixtures: fixtures/independent_refs.npz, generated by
 * scripts/testing/gen_independent_refs.py (numpy only, no torch needed — committed so CI
 * needs no Python at all).
 */
#include <gtest/gtest.h>

#include <filesystem>
#include <string>

#include "Backend.hpp"
#include "cnpy.h"
#include "layers/Layers.hpp"
#include "tensor/Tensor.hpp"

namespace
{
using Tensor = nn::Tensor;

const cnpy::npz_t& refs()
{
    static const cnpy::npz_t data = []
    {
        const std::filesystem::path p =
            std::filesystem::path(__FILE__).parent_path() / "fixtures" / "independent_refs.npz";
        return cnpy::npz_load(p.string());
    }();
    return data;
}

const cnpy::NpyArray& arr(const std::string& key)
{
    const auto it = refs().find(key);
    EXPECT_NE(it, refs().end()) << "missing fixture key: " << key;
    return it->second;
}

// Fixture arrays are numpy C-order. Only the structured accessor at(i,j) is used — the
// linear at(k) would expose backend storage order and transpose on OpenCL-family backends.
auto to_tensor(const std::string& key) -> Tensor
{
    const auto& a = arr(key);
    const auto rows = static_cast<nn::Index>(a.shape[0]);
    const auto cols = static_cast<nn::Index>(a.shape.size() > 1 ? a.shape[1] : 1);
    const float* d = a.data<float>();
    Tensor t(rows, cols);
    for (nn::Index i = 0; i < rows; ++i)
        for (nn::Index j = 0; j < cols; ++j) t.at(i, j) = d[(i * cols) + j];
    return t;
}

void expect_close(const Tensor& got, const std::string& key, float tol)
{
    const Tensor want = to_tensor(key);
    ASSERT_EQ(got.rows(), want.rows()) << key;
    ASSERT_EQ(got.cols(), want.cols()) << key;
    for (nn::Index i = 0; i < got.rows(); ++i)
        for (nn::Index j = 0; j < got.cols(); ++j)
            EXPECT_NEAR(got.at(i, j), want.at(i, j), tol) << key << " at (" << i << "," << j << ")";
}

constexpr float kTol = 1e-4F;

} // namespace

// ── SpikeTimeLoss vs an independent NumPy re-derivation ───────────────────────
// This is exactly reproducible bit-for-bit: no RNG inside the loss itself, only in
// generating the fixed, seeded random binary spike pattern used as input/target.
TEST(IndependentCrossCheck, SpikeTimeLoss)
{
    const int n = static_cast<int>(arr("spiketime_num").data<int64_t>()[0]);
    for (int i = 0; i < n; ++i)
    {
        const std::string p = "spiketime_" + std::to_string(i) + "_";
        const auto dims = arr(p + "dims").data<int64_t>();
        const int T = static_cast<int>(dims[0]);

        nn::SpikeTimeLoss loss(T);
        loss.set_target(to_tensor(p + "target"));
        Tensor pred = to_tensor(p + "input"); // time-major (T*B, F)
        Tensor l = loss.forward(pred, true);
        EXPECT_NEAR(l.at(0, 0), arr(p + "loss").data<float>()[0], kTol) << p << "loss";

        Tensor grad = loss.backward(pred);
        expect_close(grad, p + "grad_input", kTol);
    }
}

// ── PoissonLatentLayer (deterministic parts) vs an independent NumPy re-derivation ─────
// Covers: rate=softplus(z), KL term, backward (straight-through + KL gradient), and the
// inference-mode (requires_grad=false) output == rate. Does NOT cover the stochastic
// training-mode sample s~Poisson(rate*T) -- std::poisson_distribution and np.random.poisson
// are different algorithms with different RNG streams, so they cannot agree bit-for-bit
// even from "the same seed"; see PoissonLatentLayer.hpp's forward() docstring. Skipped here
// per the brief's recommendation rather than adding a statistical convergence test that
// would blur exact-math regressions behind sampling noise.
TEST(IndependentCrossCheck, PoissonLatentLayerDeterministicParts)
{
    const int n = static_cast<int>(arr("poisson_num").data<int64_t>()[0]);
    for (int i = 0; i < n; ++i)
    {
        const std::string p = "poisson_" + std::to_string(i) + "_";
        const float* prm = arr(p + "params").data<float>();
        const int T = static_cast<int>(prm[2]);
        const float prior_rate = prm[3];
        const float beta_kl = prm[4];

        nn::PoissonLatentLayer latent(T, prior_rate, beta_kl);

        // Inference path (requires_grad=false): output must equal rate=softplus(z) exactly,
        // no sampling.
        Tensor z_infer = to_tensor(p + "input");
        Tensor infer_out = latent.forward(z_infer, false);
        expect_close(infer_out, p + "rate", kTol);

        // Training path: forward populates the caches backward() needs; the returned sample
        // is stochastic and intentionally not checked (see file docstring above). kl_loss()
        // and backward()'s gradient ARE deterministic and checked.
        Tensor z_train = to_tensor(p + "input");
        (void) latent.forward(z_train, true);
        EXPECT_NEAR(latent.kl_loss(), arr(p + "kl_loss").data<float>()[0], kTol) << p << "kl_loss";

        Tensor grad_output = to_tensor(p + "grad_output");
        Tensor grad_input = latent.backward(grad_output);
        expect_close(grad_input, p + "grad_input", kTol);
    }
}
