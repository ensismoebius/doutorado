/**
 * @file pytorch_parity_gtest.cpp
 * @brief Ground-truth parity tests: compare this library against PyTorch.
 *
 * References are generated by scripts/testing/gen_pytorch_refs.py (requires
 * torch) into fixtures/pytorch_refs.npz — committed so this test needs no torch
 * at build/CI time. Each case sets the same weights + input into our layer, runs
 * forward/backward, and asserts EXPECT_NEAR against PyTorch's output/gradients.
 *
 * Regenerate after touching a covered layer:
 *   software/nn/.venv/bin/python software/nn/scripts/testing/gen_pytorch_refs.py
 */
#include <gtest/gtest.h>

#include <algorithm>
#include <cmath>
#include <cstdint>
#include <filesystem>
#include <string>

#include "cnpy.h"

#include "layers/Layers.hpp"
#include "tensor/Tensor.hpp"

namespace
{
constexpr float kTol = 1e-4F;

const cnpy::npz_t& refs()
{
    static const cnpy::npz_t data = [] {
        const std::filesystem::path p =
            std::filesystem::path(__FILE__).parent_path() / "fixtures" / "pytorch_refs.npz";
        return cnpy::npz_load(p.string());
    }();
    return data;
}

const cnpy::NpyArray& arr(const std::string& key)
{
    const auto it = refs().find(key);
    EXPECT_NE(it, refs().end()) << "missing fixture key: " << key;
    return it->second;
}

// IMPORTANT: use only the structured accessors at(i,j)/at(i,j,k)/at(i,j,k,l),
// never the linear at(k). The linear accessor exposes backend storage order
// (row-major for xtensor, column-major for the OpenCL backend), so filling a
// tensor from row-major fixture data via at(k) would transpose it on OpenCL.
// at(i,j)… address the same *logical* element on every backend. Fixture arrays
// are numpy C-order, so a C-order multi-index walk matches them.
using Shape = std::vector<nn::Index>;

Shape shape_of(const cnpy::NpyArray& a)
{
    Shape s;
    s.reserve(a.shape.size());
    for (size_t d : a.shape) s.push_back(static_cast<nn::Index>(d));
    return s;
}

float& elem(nn::Tensor& t, const Shape& i)
{
    switch (i.size())
    {
        case 2: return t.at(i[0], i[1]);
        case 3: return t.at(i[0], i[1], i[2]);
        case 4: return t.at(i[0], i[1], i[2], i[3]);
        default: throw std::invalid_argument("parity test: unsupported tensor rank");
    }
}

float elem(const nn::Tensor& t, const Shape& i)
{
    switch (i.size())
    {
        case 2: return t.at(i[0], i[1]);
        case 3: return t.at(i[0], i[1], i[2]);
        case 4: return t.at(i[0], i[1], i[2], i[3]);
        default: throw std::invalid_argument("parity test: unsupported tensor rank");
    }
}

// Advance a C-order multi-index; returns false after the last element.
bool next_index(Shape& idx, const Shape& shape)
{
    for (int d = static_cast<int>(idx.size()) - 1; d >= 0; --d)
    {
        if (++idx[static_cast<size_t>(d)] < shape[static_cast<size_t>(d)]) return true;
        idx[static_cast<size_t>(d)] = 0;
    }
    return false;
}

// Build a tensor of the fixture array's own shape, filled via structured indices.
nn::Tensor make_from(const cnpy::NpyArray& a)
{
    const Shape s = shape_of(a);
    nn::Tensor t = (s.size() == 2) ? nn::Tensor(s[0], s[1]) : nn::Tensor(s);
    const float* d = a.data<float>();
    size_t k = 0;
    Shape idx(s.size(), 0);
    do { elem(t, idx) = d[k++]; } while (next_index(idx, s));
    return t;
}

// Build a 2-D (rows x cols) tensor from a flat C-order buffer of that shape.
nn::Tensor make_2d_flat(const float* d, nn::Index rows, nn::Index cols)
{
    nn::Tensor t(rows, cols);
    for (nn::Index i = 0; i < rows; ++i)
        for (nn::Index j = 0; j < cols; ++j)
            t.at(i, j) = d[static_cast<size_t>(i) * static_cast<size_t>(cols) + static_cast<size_t>(j)];
    return t;
}

// Overwrite an existing tensor's values from a fixture array of the same shape.
void fill_from(nn::Tensor& dst, const cnpy::NpyArray& a)
{
    const Shape s = shape_of(a);
    ASSERT_EQ(static_cast<size_t>(dst.size()), a.num_vals);
    const float* d = a.data<float>();
    size_t k = 0;
    Shape idx(s.size(), 0);
    do { elem(dst, idx) = d[k++]; } while (next_index(idx, s));
}

// Compare `got` to a C-order fixture array. Iterates got's OWN logical shape and
// reads the reference in lockstep C-order, so it is agnostic to backend storage
// order AND to a rank difference that flattens the same way (e.g. our LIF output
// is 2-D (T*B,F) while the reference is 3-D (T,B,F) — same C-order sequence).
void expect_close(const nn::Tensor& got, const cnpy::NpyArray& ref, const std::string& what)
{
    ASSERT_EQ(static_cast<size_t>(got.size()), ref.num_vals) << what << ": size mismatch";
    const Shape s = got.get_shape();
    const float* d = ref.data<float>();
    size_t k = 0;
    Shape idx(s.size(), 0);
    do
    {
        EXPECT_NEAR(elem(got, idx), d[k], kTol) << what << " at C-index " << k;
        ++k;
    } while (next_index(idx, s));
}
} // namespace

// ── Linear: forward + input/weight/bias gradients ─────────────────────────────
TEST(PyTorchParity, Linear)
{
    const int n = static_cast<int>(arr("linear_num").data<int64_t>()[0]);
    for (int i = 0; i < n; ++i)
    {
        const std::string p = "linear_" + std::to_string(i) + "_";
        const auto& W = arr(p + "weight");
        const int out_f = static_cast<int>(W.shape[0]);
        const int in_f = static_cast<int>(W.shape[1]);

        nn::Linear lin(in_f, out_f);
        fill_from(lin.weight, W);
        fill_from(lin.bias, arr(p + "bias"));

        nn::Tensor x = make_from(arr(p + "input"));
        nn::Tensor y = lin.forward(x, true);
        expect_close(y, arr(p + "output"), p + "output");

        nn::Tensor go = make_from(arr(p + "grad_output"));
        nn::Tensor gi = lin.backward(go);
        expect_close(gi, arr(p + "grad_input"), p + "grad_input");
        expect_close(lin.weight.grad(), arr(p + "grad_weight"), p + "grad_weight");
        expect_close(lin.bias.grad(), arr(p + "grad_bias"), p + "grad_bias");
    }
}

// ── Elementwise activations: forward + backward ───────────────────────────────
template <typename Layer>
void check_activation(const std::string& name)
{
    const std::string p = "act_" + name + "_";
    Layer layer;
    nn::Tensor x = make_from(arr(p + "input"));
    nn::Tensor y = layer.forward(x, true);
    expect_close(y, arr(p + "output"), p + "output");

    nn::Tensor go = make_from(arr(p + "grad_output"));
    nn::Tensor gi = layer.backward(go);
    expect_close(gi, arr(p + "grad_input"), p + "grad_input");
}

TEST(PyTorchParity, Tanh) { check_activation<nn::Tanh>("tanh"); }
TEST(PyTorchParity, Sigmoid) { check_activation<nn::Sigmoid>("sigmoid"); }
TEST(PyTorchParity, ReLU) { check_activation<nn::ReLU>("relu"); }
TEST(PyTorchParity, LeakyReLU) { check_activation<nn::LeakyReLU>("leaky"); }

// ── MSELoss: scalar loss + gradient w.r.t. prediction ─────────────────────────
TEST(PyTorchParity, MSELoss)
{
    nn::MSELoss loss;
    loss.set_target(make_from(arr("mse_target")));
    nn::Tensor pred = make_from(arr("mse_pred"));
    nn::Tensor l = loss.forward(pred, true);
    EXPECT_NEAR(l.at(0, 0), arr("mse_loss").data<float>()[0], kTol);

    nn::Tensor gp = loss.backward(pred);
    expect_close(gp, arr("mse_grad_pred"), "mse_grad_pred");
}

// ── LSTMLayer: forward (all hidden states) for a batched sequence ──────────────
//
// Our LSTM uses rational-approximation sigmoid/tanh (FastActivations.hpp) for
// speed, so it cannot bit-match PyTorch's exact activations. Two checks:
//   1. Tight vs. a numpy reference using the *same* rational approximation —
//      proves the recurrence, gate order (i,f,o,g), and weight orientation are
//      correct.
//   2. Loose vs. PyTorch's exact-activation output — documents the accuracy gap
//      the fast activations introduce (bounded well under the saturation error).
TEST(PyTorchParity, LSTMLayerForward)
{
    constexpr float kApproxBound = 0.25F; // max deviation vs. exact-activation LSTM
    const int n = static_cast<int>(arr("lstm_num").data<int64_t>()[0]);
    for (int i = 0; i < n; ++i)
    {
        const std::string p = "lstm_" + std::to_string(i) + "_";
        const auto dims = arr(p + "dims").data<int64_t>();
        const int D = static_cast<int>(dims[2]);
        const int H = static_cast<int>(dims[3]);

        nn::LSTMLayer layer(D, H);
        // Fixture weights are already in our gate order (i,f,o,g) with merged bias.
        fill_from(layer.W_, arr(p + "W"));
        fill_from(layer.U_, arr(p + "U"));
        fill_from(layer.b_, arr(p + "b"));

        nn::Tensor x = make_from(arr(p + "input"));
        layer.reset_state();
        nn::Tensor y = layer.forward(x, false);

        // (1) Exact match against the same rational-approx recurrence.
        expect_close(y, arr(p + "output_approx"), p + "output_approx");

        // (2) Bounded deviation from PyTorch's exact LSTM.
        const auto& torch_out = arr(p + "output");
        ASSERT_EQ(static_cast<size_t>(y.size()), torch_out.num_vals);
        const float* d = torch_out.data<float>();
        float max_abs = 0.0F;
        {
            const Shape s = shape_of(torch_out);
            size_t k = 0;
            Shape idx(s.size(), 0);
            do
            {
                max_abs = std::max(max_abs, std::abs(elem(y, idx) - d[k]));
                ++k;
            } while (next_index(idx, s));
        }
        EXPECT_LT(max_abs, kApproxBound)
            << p << "max deviation vs. exact PyTorch LSTM = " << max_abs;
    }
}

// ── LifBPTT spiking neuron vs snnTorch Leaky ──────────────────────────────────
// Our recurrence v[t]=beta*v[t-1]+input[t], spike on v>V_th, subtract/zero reset
// matches snn.Leaky(beta, threshold, reset_mechanism). R=C=1, time_step=-ln(beta)
// so beta = exp(-time_step/(R*C)) reproduces snnTorch's beta.
TEST(PyTorchParity, LifBPTTvsSnnTorch)
{
    const int n = static_cast<int>(arr("lif_num").data<int64_t>()[0]);
    for (int i = 0; i < n; ++i)
    {
        const std::string p = "lif_" + std::to_string(i) + "_";
        const auto dims = arr(p + "dims").data<int64_t>();
        const int T = static_cast<int>(dims[0]);
        const int B = static_cast<int>(dims[1]);
        const int F = static_cast<int>(dims[2]);
        const float* prm = arr(p + "params").data<float>();
        const float time_step = prm[0];
        const float R = prm[1];
        const float C = prm[2];
        const float vth = prm[3];
        const bool reset_zero = prm[4] > 0.5F;
        const bool readout = prm[5] > 0.5F;

        nn::LifBPTT lif(T, time_step, R, C, vth, reset_zero, 0.0F, readout);

        // Fixture input is (T,B,F) C-order == time-major (T*B, F) rows (t0 batch,
        // then t1 batch, …) — exactly what LifBPTT expects.
        const auto& in = arr(p + "input");
        nn::Tensor x = make_2d_flat(in.data<float>(),
            static_cast<nn::Index>(T * B), static_cast<nn::Index>(F));

        lif.reset_state();
        nn::Tensor y = lif.forward(x, false);

        // readout → membrane (compare to snnTorch mem); spike mode → spike train.
        expect_close(y, arr(p + (readout ? "mem" : "spk")), p + (readout ? "mem" : "spk"));
    }
}

// ── LifBPTT readout backward vs snnTorch autograd (exact BPTT temporal grad) ──
// Pure leaky integrator (readout mode, no spike/reset): dL/dinput through
// v[t]=beta*v[t-1]+input[t] for loss = sum(all membranes) must match snnTorch's
// autograd exactly (no surrogate/reset involved).
TEST(PyTorchParity, LifBPTTReadoutBackward)
{
    const int n = static_cast<int>(arr("lifbw_num").data<int64_t>()[0]);
    for (int i = 0; i < n; ++i)
    {
        const std::string p = "lifbw_" + std::to_string(i) + "_";
        const auto dims = arr(p + "dims").data<int64_t>();
        const int T = static_cast<int>(dims[0]);
        const int B = static_cast<int>(dims[1]);
        const int F = static_cast<int>(dims[2]);
        const float* prm = arr(p + "params").data<float>();

        nn::LifBPTT lif(T, prm[0], prm[1], prm[2], /*V_th=*/1.0F,
            /*reset_zero=*/false, /*reset_potential=*/0.0F, /*readout_mode=*/true);

        // Arbitrary input; only the gradient path is checked (dL/dinput of a linear
        // integrator is input-independent). Fill via the structured accessor.
        nn::Tensor x(static_cast<nn::Index>(T * B), static_cast<nn::Index>(F));
        for (nn::Index r = 0; r < static_cast<nn::Index>(T * B); ++r)
            for (nn::Index c = 0; c < static_cast<nn::Index>(F); ++c)
                x.at(r, c) = 0.1F * static_cast<float>(((r * F + c) % 7) - 3);

        lif.reset_state();
        (void) lif.forward(x, true);
        // loss = sum(all membranes) → dL/d(membrane)=1 everywhere.
        nn::Tensor grad_out(static_cast<nn::Index>(T * B), static_cast<nn::Index>(F));
        for (nn::Index r = 0; r < static_cast<nn::Index>(T * B); ++r)
            for (nn::Index c = 0; c < static_cast<nn::Index>(F); ++c)
                grad_out.at(r, c) = 1.0F;

        nn::Tensor grad_in = lif.backward(grad_out);
        expect_close(grad_in, arr(p + "grad_input"), p + "grad_input");
    }
}

// ── Conv1d vs torch.nn.Conv1d (valid, stride 1) ───────────────────────────────
TEST(PyTorchParity, Conv1d)
{
    const int n = static_cast<int>(arr("conv1d_num").data<int64_t>()[0]);
    for (int i = 0; i < n; ++i)
    {
        const std::string p = "conv1d_" + std::to_string(i) + "_";
        const auto dims = arr(p + "dims").data<int64_t>();
        const int Cin = static_cast<int>(dims[1]);
        const int Cout = static_cast<int>(dims[2]);
        const int K = static_cast<int>(dims[4]);

        nn::Conv1d conv(Cin, Cout, K, /*stride=*/1, /*padding=*/0, /*dilation=*/1);
        conv.set_weights(make_from(arr(p + "weight"))); // (Cin*K, Cout)
        conv.set_bias(make_from(arr(p + "bias")));      // (1, Cout)

        nn::Tensor x = make_from(arr(p + "input"));    // (N, Cin, L)
        nn::Tensor y = conv.forward(x, false);       // (N, Cout, L-K+1)
        expect_close(y, arr(p + "output"), p + "output");
    }
}

// ── Conv2d vs torch.nn.Conv2d (valid, stride 1, square kernel) ────────────────
TEST(PyTorchParity, Conv2d)
{
    const int n = static_cast<int>(arr("conv2d_num").data<int64_t>()[0]);
    for (int i = 0; i < n; ++i)
    {
        const std::string p = "conv2d_" + std::to_string(i) + "_";
        const auto dims = arr(p + "dims").data<int64_t>();
        const int Cin = static_cast<int>(dims[1]);
        const int Cout = static_cast<int>(dims[2]);
        const int K = static_cast<int>(dims[5]);

        nn::Conv2d conv(Cin, Cout, K, /*stride=*/1, /*padding=*/0, /*dilation=*/1);
        conv.set_weights(make_from(arr(p + "weight"))); // (Cin*K*K, Cout)
        conv.set_bias(make_from(arr(p + "bias")));      // (1, Cout)

        nn::Tensor x = make_from(arr(p + "input"));    // (N, Cin, H, W)
        nn::Tensor y = conv.forward(x, false);       // (N, Cout, H-K+1, W-K+1)
        expect_close(y, arr(p + "output"), p + "output");
    }
}

// ── CrossEntropyLoss (softmax+CE, mean) vs torch ──────────────────────────────
TEST(PyTorchParity, CrossEntropyLoss)
{
    const int n = static_cast<int>(arr("ce_num").data<int64_t>()[0]);
    for (int i = 0; i < n; ++i)
    {
        const std::string p = "ce_" + std::to_string(i) + "_";
        nn::CrossEntropyLoss loss;
        loss.set_target(make_from(arr(p + "target"))); // one-hot (N,C)
        nn::Tensor logits = make_from(arr(p + "logits"));
        nn::Tensor l = loss.forward(logits, true);
        EXPECT_NEAR(l.at(0, 0), arr(p + "loss").data<float>()[0], kTol) << p << "loss";
        nn::Tensor g = loss.backward(logits);
        expect_close(g, arr(p + "grad_logits"), p + "grad_logits");
    }
}

// ── MaxPool1d / MaxPool2d (forward) vs torch ──────────────────────────────────
TEST(PyTorchParity, MaxPool1d)
{
    const int n = static_cast<int>(arr("maxpool1d_num").data<int64_t>()[0]);
    for (int i = 0; i < n; ++i)
    {
        const std::string p = "maxpool1d_" + std::to_string(i) + "_";
        const auto pr = arr(p + "params").data<int64_t>();
        nn::MaxPool1d pool(static_cast<int>(pr[0]), static_cast<int>(pr[1]));
        nn::Tensor x = make_from(arr(p + "input"));   // (N, C, L)
        nn::Tensor y = pool.forward(x, false);
        expect_close(y, arr(p + "output"), p + "output");
    }
}

TEST(PyTorchParity, MaxPool2d)
{
    const int n = static_cast<int>(arr("maxpool2d_num").data<int64_t>()[0]);
    for (int i = 0; i < n; ++i)
    {
        const std::string p = "maxpool2d_" + std::to_string(i) + "_";
        const auto pr = arr(p + "params").data<int64_t>();
        nn::MaxPool2d pool(static_cast<int>(pr[0]), static_cast<int>(pr[1]));
        nn::Tensor x = make_from(arr(p + "input"));   // (N, C, H, W)
        nn::Tensor y = pool.forward(x, false);
        expect_close(y, arr(p + "output"), p + "output");
    }
}
